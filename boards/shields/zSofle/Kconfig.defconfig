## boards/shields/zSofle/Kconfig.defconfig
```kconfig
if ZSOFLE_LEFT

# Name must be less than 16 characters long!
config ZMK_KEYBOARD_NAME
    default "zSofle"

config ZMK_SPLIT_ROLE_CENTRAL
    default y

endif

if SHIELD_ZSOFLE_LEFT || SHIELD_ZSOFLE_RIGHT

config ZMK_SPLIT
    default y

endif
```

## boards/shields/zsofle_left/Kconfig.defconfig
```kconfig
if ZSOFLE_LEFT

# Name must be less than 16 characters long!
config ZMK_KEYBOARD_NAME
    default "zsofle"

config ZMK_SPLIT_ROLE_CENTRAL
    default y

endif

if SHIELD_ZSOFLE_LEFT || SHIELD_ZSOFLE_RIGHT

config ZMK_SPLIT
    default y

endif
```
